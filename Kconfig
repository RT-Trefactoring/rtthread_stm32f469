## Kconfig
```kconfig
mainmenu "RT-Thread Configuration"

config $BSP_DIR
    string
    option env="BSP_ROOT"
    default "."

config $RTT_DIR
    string
    default "rt-thread"

config $PKGS_DIR
    string
    option env="PKGS_ROOT"
    default "packages"

source "$RTT_DIR/Kconfig"
source "$PKGS_DIR/Kconfig"

config SOC_STM32F469NI
    bool 
    select ARCH_ARM_CORTEX_M4
    default y

config ARCH_ARM_CORTEX_FPU
    default y

menu "STM32 Bsp Config" 

choice
    prompt "Heap select"
    default BSP_USING_HEAP_SRAM_SDRAM
    config BSP_USING_HEAP_SRAM
        bool "310K sram"
    config BSP_USING_HEAP_SRAM_SDRAM
        bool "310K sram + 8MB sdram"
        select BSP_USING_SDRAM
endchoice

menu "Select uart drivers"
    config BSP_USING_UART1
        bool "Using uart1"
        select RT_USING_SERIAL
        default n    

    config BSP_USING_UART2
        bool "Using uart2"
        select RT_USING_SERIAL
        default n    

    config BSP_USING_UART3
        bool "Using uart3"
        select RT_USING_SERIAL
        default y   

    config BSP_USING_UART6
        bool "Using uart6"
        select RT_USING_SERIAL
        default n   
endmenu

menu "Select pin drivers"
    config BSP_USING_PIN
        bool "Using pin"
        select RT_USING_PIN
        default y 
endmenu

menu "Select i2c bus drivers"
    config BSP_USING_I2C2
        bool "Using i2c2(Pin simulation)"
        select RT_USING_I2C
        select RT_USING_I2C_BITOPS
        default n 
endmenu

menu "Select spi bus drivers"
    config BSP_USING_SPI1
        bool "Using spi1 bus"
        select RT_USING_SPI
        default n 

    config BSP_USING_SPI2
        bool "Using spi2 bus"
        select RT_USING_SPI
        default n  
    if BSP_USING_SPI1 || BSP_USING_SPI2
        config SPI_USING_DMA
            bool "Enable dma on spi"
            default y
    endif
endmenu

menu "Select sdram drivers"
    config BSP_USING_SDRAM
        bool "Using 16mbytes sdram" 
        default n 
endmenu

menu "Select audio drivers"
    config BSP_USING_AUDIO
        bool "Using audio" 
        default n 
        select BSP_USING_I2C2
    config BSP_USING_AUDIO_IN
        bool "Using audio in" 
        default n 
endmenu

menu "Select sdcard drivers"
    config BSP_USING_SDCARD
        bool "Using sdcard" 
        default y 
        select RT_USING_DFS

    choice
        prompt "Drive type select"
        default BSP_USING_SDCARD_BLOCK
        depends on BSP_USING_SDCARD

        config BSP_USING_SDCARD_BLOCK
            bool "Block type" 
        config BSP_USING_SDCARD_SDIO_BUS
            bool "SDIO bus type"
            select RT_USING_SDIO 
            select PKG_USING_STM32_SDIO
    endchoice

    config BSP_USING_SDCARD_MOUNT
        bool "Enable sdcard mount" 
        default y 
        depends on BSP_USING_SDCARD
    
    config BSP_USING_SDCARD_PATH_MOUNT
        string "Path of sdcard mount"
        default "/mnt/sd" 
        depends on BSP_USING_SDCARD && BSP_USING_SDCARD_MOUNT
endmenu

menu "Select lcd drivers"
    config BSP_USING_LCD
        bool "Using lcd" 
        default n 
        select BSP_USING_SDRAM
endmenu

menu "Select ramdisk drivers"
    config BSP_USING_RAMDISK
        bool "Using ramdisk" 
        default y 
        select BSP_USING_SDRAM

    config BSP_USING_RAMDISK_SIZE
        int "Ramdisk size(MB)" 
        default 4  
        depends on BSP_USING_RAMDISK 

    config BSP_USING_RAMDISK_MOUNT
        bool "Enable ramdisk mount" 
        default y 
        depends on BSP_USING_RAMDISK

    config BSP_USING_RAMDISK_PATH_MOUNT
        string "Path of ramdisk mount"
        default "/mnt/tmp" 
        depends on BSP_USING_RAMDISK 
endmenu

menu "Select qspi flash drivers"
    config BSP_USING_QSPI_FLASH
        bool "Using qspi flash" 
        default y 
        select RT_USING_MTD_NOR

    config BSP_USING_QSPI_FLASH_MOUNT
        bool "Enable qspi flash mount" 
        default y 
        select PKG_USING_LITTLEFS
        depends on BSP_USING_QSPI_FLASH

    config BSP_USING_QSPI_FLASH_PATH_MOUNT
        string "Path of qspi flash mount"
        default "/mnt/flash" 
        depends on BSP_USING_QSPI_FLASH 
endmenu

menu "Select PWM drivers"
menuconfig BSP_USING_PWM1
    bool "Using PWM1"
    select RT_USING_PWM
    default n

if BSP_USING_PWM1
    config BSP_USING_PWM1_CH1
        bool "Enable Channel 1 (PA8)"
        default n
    config BSP_USING_PWM1_CH2
        bool "Enable Channel 2 (PA9)"
        default n
    config BSP_USING_PWM1_CH3
        bool "Enable Channel 3 (PA10)"
        default n
    config BSP_USING_PWM1_CH4
        bool "Enable Channel 4 (PA11)"
        default n
endif

menuconfig BSP_USING_PWM2
    bool "Using PWM2"
    select RT_USING_PWM
    default n

if BSP_USING_PWM2
    config BSP_USING_PWM2_CH1
        bool "Enable Channel 1 (PA5)"
        default n
    config BSP_USING_PWM2_CH2
        bool "Enable Channel 2 (PB3)"
        default n
    config BSP_USING_PWM2_CH3
        bool "Enable Channel 3 (PB10)"
        default n
    config BSP_USING_PWM2_CH4
        bool "Enable Channel 4 (PA3)"
        default n
endif

menuconfig BSP_USING_PWM3
    bool "Using PWM3"
    select RT_USING_PWM
    default n

if BSP_USING_PWM3
    config BSP_USING_PWM3_CH1
        bool "Enable Channel 1 (PA6)"
        default n
    config BSP_USING_PWM3_CH2
        bool "Enable Channel 2 (PA7)"
        default n
    config BSP_USING_PWM3_CH3
        bool "Enable Channel 3 (PB0)"
        default n
    config BSP_USING_PWM3_CH4
        bool "Enable Channel 4 (PB1)"
        default n
endif

menuconfig BSP_USING_PWM4
    bool "Using PWM4"
    select RT_USING_PWM
    default n

if BSP_USING_PWM4
    config BSP_USING_PWM4_CH1
        bool "Enable Channel 1 (PB6)"
        default n
    config BSP_USING_PWM4_CH2
        bool "Enable Channel 2 (PB7)"
        default n
    config BSP_USING_PWM4_CH3
        bool "Enable Channel 3 (PB8)"
        default n
    config BSP_USING_PWM4_CH4
        bool "Enable Channel 4 (PB9)"
        default n
endif

menuconfig BSP_USING_PWM5
    bool "Using PWM5"
    select RT_USING_PWM
    default n

if BSP_USING_PWM5
    config BSP_USING_PWM5_CH1
        bool "Enable Channel 1 (PA0)"
        default n
    config BSP_USING_PWM5_CH2
        bool "Enable Channel 2 (PA1)"
        default n
    config BSP_USING_PWM5_CH3
        bool "Enable Channel 3 (PA2)"
        default n
endif
endmenu

endmenu 
```
